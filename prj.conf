## CMakeLists.txt
```
cmake_minimum_required(VERSION 3.20.0)
find_package(Zephyr REQUIRED HINTS $ENV{ZEPHYR_BASE})
project(buttons-up)

FILE(GLOB app_sources src/*.c*)
target_sources(app PRIVATE ${app_sources})
```

## prj.conf
```kconfig
# Bluetooth
CONFIG_BT=y
CONFIG_BT_SMP=y
CONFIG_BT_PERIPHERAL=y
CONFIG_BT_DIS=y
CONFIG_BT_BAS=y
CONFIG_BT_DEVICE_NAME="Buttons Up"
CONFIG_BT_DEVICE_APPEARANCE=961

# GPIO
CONFIG_GPIO=y

# Logging
CONFIG_LOG=y
CONFIG_BT_LOG_LEVEL_INF=y
CONFIG_SETTINGS_LOG_LEVEL_INF=y
CONFIG_LOG_DEFAULT_LEVEL=3

# Power management
CONFIG_PM=y
CONFIG_PM_DEVICE=y
```

## src/main.c
```c
#include <errno.h>
#include <stddef.h>
#include <string.h>
#include <zephyr/types.h>

#include <zephyr/drivers/gpio.h>
#include <zephyr/kernel.h>
#include <zephyr/logging/log.h>
#include <zephyr/sys/byteorder.h>

#include <zephyr/bluetooth/bluetooth.h>
#include <zephyr/bluetooth/conn.h>
#include <zephyr/bluetooth/gatt.h>
#include <zephyr/bluetooth/hci.h>
#include <zephyr/bluetooth/uuid.h>

#include <zephyr/pm/pm.h>
#include <zephyr/pm/device.h>
#include <hal/nrf_gpio.h>

#include "hids_button.h"

#define BUTTON_TIMEOUT 2000

LOG_MODULE_REGISTER(buttons_up);

const struct gpio_dt_spec sw0 = GPIO_DT_SPEC_GET(DT_ALIAS(sw0), gpios);
const struct gpio_dt_spec led0 = GPIO_DT_SPEC_GET(DT_ALIAS(led0), gpios);

const struct bt_data ad[] = {
    BT_DATA_BYTES(BT_DATA_FLAGS, (BT_LE_AD_GENERAL | BT_LE_AD_NO_BREDR)),
    BT_DATA_BYTES(BT_DATA_UUID16_ALL, BT_UUID_16_ENCODE(BT_UUID_HIDS_VAL),
                  BT_UUID_16_ENCODE(BT_UUID_BAS_VAL)),
};

static void connected(struct bt_conn *conn, uint8_t err) {
  char addr[BT_ADDR_LE_STR_LEN];
  bt_addr_le_to_str(bt_conn_get_dst(conn), addr, sizeof(addr));

  if (err) {
    LOG_ERR("Failed to connect to %s (%u)", addr, err);
    return;
  }

  LOG_INF("Connected %s", addr);

  if (bt_conn_set_security(conn, BT_SECURITY_L2)) {
    LOG_ERR("Failed to set security\n");
  }
}

static void disconnected(struct bt_conn *conn, uint8_t reason) {
  char addr[BT_ADDR_LE_STR_LEN];
  bt_addr_le_to_str(bt_conn_get_dst(conn), addr, sizeof(addr));
  LOG_INF("Disconnected from %s (reason 0x%02x)", addr, reason);
}

static void security_changed(struct bt_conn *conn, bt_security_t level,
                             enum bt_security_err err) {
  char addr[BT_ADDR_LE_STR_LEN];
  bt_addr_le_to_str(bt_conn_get_dst(conn), addr, sizeof(addr));
  if (!err) {
    LOG_INF("Security changed: %s level %u", addr, level);
  } else {
    LOG_ERR("Security failed: %s level %u err %d", addr, level, err);
  }
}

BT_CONN_CB_DEFINE(conn_callbacks) = {
    .connected = connected,
    .disconnected = disconnected,
    .security_changed = security_changed,
};

static void bt_ready(int err) {
  if (err) {
    LOG_ERR("Bluetooth init failed (err %d)", err);
    return;
  }
  err = bt_le_adv_start(BT_LE_ADV_CONN_NAME, ad, ARRAY_SIZE(ad), NULL, 0);
  if (err) {
    LOG_ERR("Advertising failed to start (err %d)", err);
    return;
  }
}

void turn_system_off() {
  // Blink led
  gpio_pin_set_dt(&led0, 1);
  for (int i = 0; i < 5; i++) {
    k_msleep(100);
    gpio_pin_toggle_dt(&led0);
  }
  // Configure to generate PORT event (wakeup) on button press
	nrf_gpio_cfg_input(NRF_DT_GPIOS_TO_PSEL(DT_ALIAS(sw0), gpios),
			   NRF_GPIO_PIN_PULLUP);
	nrf_gpio_cfg_sense_set(NRF_DT_GPIOS_TO_PSEL(DT_ALIAS(sw0), gpios),
			       NRF_GPIO_PIN_SENSE_LOW);
  // Turn off
  pm_state_force(0u, &(struct pm_state_info){PM_STATE_SOFT_OFF, 0, 0});
  k_msleep(1000); // 1 Second delay for turning off
}

void button_loop() {
  int64_t uptime = k_uptime_get();
  for (;;) {
    if (notify_enabled()) {
      if (gpio_pin_get_dt(&sw0)) {
        gpio_pin_set_dt(&led0, 1);
        if (k_uptime_get() - uptime > BUTTON_TIMEOUT) {
          break;
        }
        notify_volume_down(NULL);
      }
      else {
        uptime = k_uptime_get();
        notify_no_key(NULL);
      }
    }
    k_msleep(100);
    gpio_pin_set_dt(&led0, 0);
  }
  turn_system_off();
}

int gpio_init() {
  int err;
  err = gpio_pin_configure_dt(&sw0, GPIO_INPUT);
  if (err) {
    LOG_ERR("Error %d: failed to configure %s pin %d", err, sw0.port->name, sw0.pin);
    return err;
  }
  // Init led0
  err = gpio_pin_configure_dt(&led0, GPIO_OUTPUT_INACTIVE);
  if (err) {
    LOG_ERR(
      "Error %d: failed to configure %s pin %d",
      err, led0.port->name, led0.pin
    );
  }
  return err;
}

void main(void) {
  int err = bt_enable(bt_ready);
  if (err) {
    LOG_ERR("Bluetooth init failed (err %d)\n", err);
    return;
  }
  gpio_init();
  button_loop();
}
```

## src/hids_button.c
```c
#include "hids_button.h"

static struct hids_info info = {
    .version = 0x0111,
    .code = 0x0002,
    .flags = BIT(1), // Normally Connectable
};

static struct hids_report input = {
    .id = 0x01,
    .type = 0x01, // Input
};

static uint8_t ctrl_point;

static const uint8_t report_map[] = {
    0x05, 0x01, // Usage Page (Generic Desktop)
    0x09, 0x06, // Usage (Keyboard)
    0xA1, 0x01, // Collection (Application)
    // Modifier byte
    0x05, 0x07, //   Usage Page (Key Codes)
    0x19, 0xE0, //   Usage Minimum (Keyboard Left Control)
    0x29, 0xE7, //   Usage Maximum (Keyboard Right GUI)
    0x15, 0x00, //   Logical Minimum (0)
    0x25, 0x01, //   Logical Maximum (1)
    0x75, 0x01, //   Report Size (1)
    0x95, 0x08, //   Report Count (8)
    0x81, 0x02, //   Input (Data, Variable, Absolute)
    // Reserved byte
    0x95, 0x01, //   Report Count (1)
    0x75, 0x08, //   Report Size (8)
    0x81, 0x01, //   Input (Constant)
    // Key array (2 bytes)
    0x95, 0x02, //   Report Count (2)
    0x75, 0x08, //   Report Size (8)
    0x15, 0x00, //   Logical Minimum (No event indicated)
    0x25, 0x81, //   Logical Maximum (Keyboard Volume Down)
    0x05, 0x07, //   Usage Page (Key Codes)
    0x19, 0x00, //   Usage Minimum (No event indicated)
    0x29, 0x81, //   Usage Maximum (Keyboard Volume Down)
    0x81, 0x00, //   Input (Data, Array)
    0xC0,       // End collection
};

static bool notify_enabled_internal = false;

static ssize_t read_info(struct bt_conn *conn, const struct bt_gatt_attr *attr,
                         void *buf, uint16_t len, uint16_t offset) {
  return bt_gatt_attr_read(conn, attr, buf, len, offset, attr->user_data,
                           sizeof(struct hids_info));
}

static ssize_t read_report_map(struct bt_conn *conn,
                               const struct bt_gatt_attr *attr, void *buf,
                               uint16_t len, uint16_t offset) {
  return bt_gatt_attr_read(conn, attr, buf, len, offset, report_map,
                           sizeof(report_map));
}

static ssize_t read_report(struct bt_conn *conn,
                           const struct bt_gatt_attr *attr, void *buf,
                           uint16_t len, uint16_t offset) {
  return bt_gatt_attr_read(conn, attr, buf, len, offset, attr->user_data,
                           sizeof(struct hids_report));
}

static ssize_t read_input_report(struct bt_conn *conn,
                                 const struct bt_gatt_attr *attr, void *buf,
                                 uint16_t len, uint16_t offset) {
  return bt_gatt_attr_read(conn, attr, buf, len, offset, NULL, 0);
}

static void input_ccc_changed(const struct bt_gatt_attr *attr, uint16_t value)
{
	notify_enabled_internal = value == BT_GATT_CCC_NOTIFY;
}

static ssize_t write_ctrl_point(struct bt_conn *conn,
				const struct bt_gatt_attr *attr,
				const void *buf, uint16_t len, uint16_t offset,
				uint8_t flags)
{
	uint8_t *value = attr->user_data;
	if (offset + len > sizeof(ctrl_point)) {
		return BT_GATT_ERR(BT_ATT_ERR_INVALID_OFFSET);
	}
	memcpy(value + offset, buf, len);
	return len;
}

// Define HID service
BT_GATT_SERVICE_DEFINE(
    button_service, BT_GATT_PRIMARY_SERVICE(BT_UUID_HIDS),
    BT_GATT_CHARACTERISTIC(BT_UUID_HIDS_INFO, BT_GATT_CHRC_READ,
                           BT_GATT_PERM_READ, read_info, NULL, &info),
    BT_GATT_CHARACTERISTIC(BT_UUID_HIDS_REPORT_MAP, BT_GATT_CHRC_READ,
                           BT_GATT_PERM_READ, read_report_map, NULL, NULL),
    BT_GATT_CHARACTERISTIC(BT_UUID_HIDS_REPORT,
                           BT_GATT_CHRC_READ | BT_GATT_CHRC_NOTIFY,
                           BT_GATT_PERM_READ_ENCRYPT, read_input_report, NULL,
                           NULL),
    BT_GATT_CCC(input_ccc_changed, BT_GATT_PERM_READ_ENCRYPT | BT_GATT_PERM_WRITE_ENCRYPT),
    BT_GATT_DESCRIPTOR(BT_UUID_HIDS_REPORT_REF, BT_GATT_PERM_READ, read_report,
                       NULL, &input),
	BT_GATT_CHARACTERISTIC(BT_UUID_HIDS_CTRL_POINT, BT_GATT_CHRC_WRITE_WITHOUT_RESP,
			       BT_GATT_PERM_WRITE, NULL, write_ctrl_point, &ctrl_point));


int notify_volume_down(struct bt_conn *conn) {
    const uint8_t report[] = {0, 0, VOLUME_DOWN_KEY, 0, 0, 0, 0, 0};
    return bt_gatt_notify(conn, &button_service.attrs[5], report, sizeof(report));
}

int notify_no_key(struct bt_conn *conn) {
    const uint8_t report[8] = { 0 };
    return bt_gatt_notify(conn, &button_service.attrs[5], report, sizeof(report));
}

bool notify_enabled() {
    return notify_enabled_internal;
}
```

## src/hids_button.h
```c
#ifndef HIDS_BUTTON
#define HIDS_BUTTON

#include <zephyr/kernel.h>
#include <stdbool.h>

#include <zephyr/bluetooth/bluetooth.h>
#include <zephyr/bluetooth/conn.h>
#include <zephyr/bluetooth/gatt.h>
#include <zephyr/bluetooth/hci.h>
#include <zephyr/bluetooth/uuid.h>

 // Key for taking picture on iPhone and Android cameras
#define VOLUME_DOWN_KEY 0x81

struct hids_info {
  uint16_t version; // Version number of USB HID specification
  uint16_t code;    // Country HID Device hardware is localized for
  uint8_t flags;
} __packed;

struct hids_report {
  uint8_t id;   // Report ID
  uint8_t type; // Report Type
} __packed;

int notify_volume_down(struct bt_conn *conn);

int notify_no_key(struct bt_conn *conn);

bool notify_enabled();

#endif
```
